## drivers/firmware/cirrus/Kconfig
```kconfig
# SPDX-License-Identifier: GPL-2.0-only

config FW_CS_DSP
	tristate "Cirrus Logic DSP firmware support"
	default n
	help
	  Support library for loading firmware and tunings onto Cirrus Logic
	  Halo Core and ADSP DSPs. It is selected by the in-tree codec drivers
	  that need it; enable it explicitly for out-of-tree codec drivers.
```

## drivers/input/fingerprint/Kconfig
```kconfig
# SPDX-License-Identifier: GPL-2.0-only

menuconfig INPUT_FINGERPRINT
	bool "Fingerprint sensors"
	help
	  Say Y here to get a list of fingerprint sensor drivers.

if INPUT_FINGERPRINT

source "drivers/input/fingerprint/mi_fp/Kconfig"

endif
```

## drivers/input/fingerprint/mi_fp/Kconfig
```kconfig
# SPDX-License-Identifier: GPL-2.0-only

config FINGERPRINT_MI_FP
	tristate "Xiaomi fingerprint sensor driver"
	depends on DRM && NET && OF && QCOM_PANEL_EVENT_NOTIFIER
	help
	  Platform driver for the fingerprint sensors on Xiaomi phones. It
	  handles the sensor power, reset and interrupt lines and, for the
	  Qualcomm ultrasonic sensors, the finger detect and IPC interrupts
	  the fingerprint HAL and trusted application rely on.

	  To compile this driver as a module, choose M here: the module will
	  be called mi_fp.
```

## drivers/misc/hwid/Kconfig
```kconfig
# SPDX-License-Identifier: GPL-2.0-only

config MI_HARDWARE_ID
	tristate "Xiaomi hardware ID"
	depends on QCOM_SOCINFO
	help
	  Exposes the board description the Xiaomi bootloader passes on the
	  kernel command line (hwid.project, hwid.hwid_value, hwid.project_adc
	  and hwid.build_adc) to the drivers that adapt to the project,
	  hardware revision or sales region.

	  To compile this driver as a module, choose M here: the module will
	  be called hwid.
```

## drivers/misc/mitee/Kconfig
```kconfig
# SPDX-License-Identifier: GPL-2.0-only
config MITEE
	tristate "Xiaomi MiTEE driver"
	depends on ARM64 && OF
	depends on GH_MSGQ && GH_RM_DRV
	depends on QCOM_SCM && QCOM_SECURE_BUFFER && QCOM_MINIDUMP
	depends on CRYPTO_SHA1
	depends on TEE = n
	select GENERIC_ALLOCATOR
	help
	  Driver for MiTEE, Xiaomi's OP-TEE based trusted execution
	  environment running in a Gunyah virtual machine. It provides the
	  TEE client and supplicant devices (/dev/tee0, /dev/teepriv0), the
	  TEE log (/proc/mitee_log) and the trusted UI devices
	  (/dev/mitee-tui, /dev/mitee-tui-supp).

	  It carries its own instance of the TEE subsystem and cannot be used
	  together with CONFIG_TEE.

	  To compile this driver as a module, choose M here: the module will
	  be called mitee_dlkm.
```

## drivers/power/supply/mca/Kconfig
```kconfig
# SPDX-License-Identifier: GPL-2.0-only

config XM_POWER_SUPPLY
	tristate "Xiaomi MCA charging stack"
	depends on QTI_PMIC_GLINK
	depends on QCOM_SMEM
	depends on QCOM_PANEL_EVENT_NOTIFIER
	depends on MI_HARDWARE_ID
	depends on QTI_BATTERY_CHARGER=n
	help
	  Xiaomi's Mi Charging Architecture (MCA), the charging stack of
	  Xiaomi phones whose battery charger runs on the ADSP: platform
	  class drivers, charging strategies, the battery and charger power
	  supplies, and the drivers for the BQ27Z561 fuel gauge, the SC8581
	  charge pump and the NU1652 wireless receiver.

	  The stack replaces the QTI battery charger client on the same PMIC
	  Glink channel and exports the battery charger interface in its
	  place, so the two cannot be enabled together.

	  All parts are built as separate modules, named as on the stock
	  firmware.
```
